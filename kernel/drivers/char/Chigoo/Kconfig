## kernel/drivers/char/Chigoo/Kconfig
```kconfig
#
# Chigoo device configuration
#
menuconfig CHIGOO_DRIVER
	tristate "CHIGOO Hardware Support"
	
if CHIGOO_DRIVER

config CHIGOO_DRIVER_MCU
	tristate "CHIGOO Cpu Communicate With Mcu"
	depends on CHIGOO_DRIVER
	
config CHIGOO_DRIVER_CHARGE
	tristate "CHIGOO Cpu Get Battery Value"
	depends on CHIGOO_DRIVER

endif
```

## kernel/drivers/char/Chigoo/mcu_communication/Kconfig
```kconfig
menu "MCU" 

comment"MCU Driver" 

config MCU 

	tristate "MCU_COMMUNICATION" 

	default y

  config MCU_COMM_DEBUG
	depends on MCU
	tristate "MCU_COMM_DEBEG"
	default n
endmenu
```
